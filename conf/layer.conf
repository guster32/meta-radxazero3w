## conf/layer.conf
```bitbake
# We have a conf and classes directory, add to BBPATH
BBPATH .= ":${LAYERDIR}"

# We have recipes-* directories, add to BBFILES
BBFILES += "${LAYERDIR}/recipes-*/*/*.bb \
            ${LAYERDIR}/recipes-*/*/*.bbappend"

BBFILE_COLLECTIONS += "meta-radxazero3w"
BBFILE_PATTERN_meta-radxazero3w = "^${LAYERDIR}/"
BBFILE_PRIORITY_meta-radxazero3w = "6"

LAYERDEPENDS_meta-radxazero3w = "core"
LAYERSERIES_COMPAT_meta-radxazero3w = "nanbield scarthgap"
```

## conf/machine/radxa-zero3w.conf
```bitbake
#@TYPE: Machine
#@NAME: raxda-zero3w
#@DESCRIPTION: Machine configuration for raxda-zero3w systems
#@MAINTAINER: Gustavo Branco <guster32@gmail.com>

require conf/machine/include/arm/armv8-2a/tune-cortexa55.inc
require conf/machine/include/soc-family.inc
require conf/machine/include/bootfiles.inc

SOC_FAMILY = "rockchip:rk3566"

MACHINE_FEATURES:append = " emmc "

PREFERRED_PROVIDER_virtual/kernel ?= "linux-yocto"
PREFERRED_VERSION_linux-yocto-dev ?= "6.6%"
# PREFERRED_VERSION_mesa ?= "24.2.3"
MACHINE_EXTRA_RRECOMMENDS = "kernel-modules kernel-devicetree"
KERNEL_IMAGETYPE = "Image"
KERNEL_DEVICETREE = "rockchip/rk3566-radxa-zero-3w-aic8800ds2.dtb"

PREFERRED_PROVIDER_virtual/bootloader = "u-boot-radxa"
PREFERRED_PROVIDER_u-boot = "u-boot-radxa"
PREFERRED_VERSION_u-boot = "2023.10"

UBOOT_MACHINE = "radxa-zero3-rk3566_defconfig"
UBOOT_BINARY = "u-boot.bin"
UBOOT_LOAD_CMD = "load"
UBOOT_BOOTPART = "${partition}"
UBOOT_FILE_TITLE = "RADXAZERO3W-UBOOT-CONFIG"
UBOOT_EXTRA_ENV = "setenv bootlabel YOCTO WIC"
BOOT_PREFIX = ""
SERIAL_CONSOLES = "1500000;ttyS2"
UBOOT_CONSOLE = "console=ttyS2,1500000 earlycon"
UBOOT_XTRA_CMDLINE = "splash quiet vt.global_cursor_default=0"
UBOOT_ENTRYPOINT = "${kernel_addr_c}"
UBOOT_FDT_LOADADDR = "${fdt_addr_r}"
UBOOT_LOADADDRESS = "${kernel_addr_r}"

# We use booti and Image for booting an uncompressed Linux kernel image (Image) on ARM64 (AArch64) architecture
UBOOT_BOOT_CMD = "booti"
UBOOT_KERNEL_NAME = "${KERNEL_IMAGETYPE}-initramfs-${MACHINE}.bin"
UBOOT_ROOT_mmc = "mmcblk0p2"
UBOOT_VIDEO = "video=HDMI-A-1:1024x768@75"

UBOOT_ROOT_nvme = "nvme0n1p2"
UBOOT_ROOT = "${UBOOT_ROOT_mmc}"
UBOOT_ENV  = "boot"
UBOOT_ENV_SUFFIX ?= "scr"
ARCH = "arm64"
UBOOT_SCRIPT = "boot.${UBOOT_ENV_SUFFIX}"
IMAGE_BOOT_FILES = "${UBOOT_SCRIPT} ${UBOOT_KERNEL_NAME} ${@make_dtb_boot_files(d)}"

PREFERRED_PROVIDER_virtual/gpu = "mesa"


IMAGE_FSTYPES = " ext4 wic wic.xz wic.bmap"
WIC_CREATE_EXTRA_ARGS = " --no-fstab-update "
WKS_FILE = "radxa-zero3w.wks"
EXTRA_IMAGEDEPENDS:append = " u-boot "
IMAGE_INSTALL:append = " kernel-devicetree"
```
